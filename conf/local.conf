## conf/local.conf
```bitbake
# CONF_VERSION is increased each time build/conf/ changes incompatibly
CONF_VERSION = "1"

INHERIT += "rm_work"

# Which files do we want to parse:
BBMASK = "(openjdk|qtbase)"

# Machine

MACHINE = "beaglebone"

# Build U-Boot initramfs images
IMAGE_CLASSES = "image_types_uboot"
IMAGE_TYPES = "cpio.gz.u-boot"
IMAGE_FSTYPES = "cpio.gz.u-boot"

# Disable ISO image by default
NOISO = "1"

# Avoid dragging in core-image-minimal-initramfs, which drags in grub which in turn fails to build
INITRD_IMAGE = "small-image"

# Make use of SMP:
#   PARALLEL_MAKE specifies how many concurrent compiler threads are spawned per bitbake process
#   BB_NUMBER_THREADS specifies how many concurrent bitbake tasks will be run
PARALLEL_MAKE     = "-j2"
BB_NUMBER_THREADS = "8"

VIRTUAL-RUNTIME_init_manager = "sysvinit"

DISTRO_FEATURES_append = " sysvinit"
DISTRO_FEATURES_BACKFILL = "sysvinit"
DISTRO_FEATURES_BACKFILL_CONSIDERED = "systemd"

PREFERRED_PROVIDER_glibc = "glibc"
PREFERRED_PROVIDER_libevent = "libevent"

DISTRO = "angstrom-v2014.12"

# Set DEPLOY_DIR outside of TMPDIR

DEPLOY_DIR = "${TMPDIR}/../../deploy/${TCLIBC}"
# Don't generate the mirror tarball for SCM repos, the snapshot is enough
BB_GENERATE_MIRROR_TARBALLS = "0"

# Disable build time patch resolution. This would lauch a devshell
# and wait for manual intervention. We disable it.
PATCHRESOLVE = "noop"

#
# Shared-state files from other locations
#
# Shared state files are prebuilt cache data objects which can 
# used to accelerate build time. This variable can be used to configure the system
# to search other mirror locations for these objects before it builds the data itself.
#
# This can be a filesystem directory, or a remote url such as http or ftp. These
# would contain the sstate-cache results from previous builds (possibly from other 
# machines). This variable works like fetcher MIRRORS/PREMIRRORS and points to the 
# cache locations to check for the shared objects.
#SSTATE_MIRRORS ?= "\
#file://.* http://someserver.tld/share/sstate/ \n \
#file://.* file:///some/local/dir/sstate/"

#SSTATE_MIRRORS ?= "\
#file://.* http://dominion.thruhere.net/angstrom/sstate-mirror/ \n "

# enable PR service on build machine itself
# its good for a case when this is the only builder
# generating the feeds
#
PRSERV_HOST = "localhost:0"
```
